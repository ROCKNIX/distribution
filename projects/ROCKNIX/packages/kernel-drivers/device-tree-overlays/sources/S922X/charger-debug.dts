/dts-v1/;
/plugin/;

/ {
    fragment@0 {
        target = <&rk818>;
        __overlay__ {
            // Enable debug
            charger {
                debug;
            };
        };
    };
};

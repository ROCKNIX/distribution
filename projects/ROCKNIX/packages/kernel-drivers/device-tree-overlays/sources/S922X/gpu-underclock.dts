/dts-v1/;
/plugin/;

/ {
    fragment@0 {
        target = <&gpu_opp_table>;
        __overlay__ {
            // Disable 800 Mhz frequency
            opp-799999987 {
                status = "disabled";
            };
        };
    };
};

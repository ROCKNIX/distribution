// SPDX-License-Identifier: BSD-3-Clause
/*
 * Copyright (C) 2026-present ROCKNIX (https://github.com/ROCKNIX).
 */

/dts-v1/;

#include "sm4450-retroid-pocket-classic.dts"

/ {
	model = "Retroid Pocket Classic 6";
};

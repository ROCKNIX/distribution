## projects/ROCKNIX/devices/RK3576/vendor/rock4d-6.1-orig/sec_ts/Kconfig
```kconfig
#
# Samsung Electronics TOUCH driver configuration
#

config TOUCHSCREEN_SEC_TS_1223
        tristate "Samsung Electronics Touchscreen 1223"
        depends on I2C
        help
          Say Y here if you want support for SEC touchscreen controllers.
          If unsure, say N.

          To compile this driver as a module, choose M here: the
          module will be called sec_ts.
```

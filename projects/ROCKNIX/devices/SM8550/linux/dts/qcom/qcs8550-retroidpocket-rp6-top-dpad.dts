// SPDX-License-Identifier: BSD-3-Clause
/*
 * Copyright (C) 2026-present ROCKNIX (https://github.com/ROCKNIX).
 */

/dts-v1/;

#include "qcs8550-retroidpocket-rp6.dts"

&gamepad {
    invert-x;
    invert-y;
};
